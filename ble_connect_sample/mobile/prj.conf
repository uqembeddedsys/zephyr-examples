## CMakeLists.txt
```
# SPDX-License-Identifier: Apache-2.0
#Setting to exclusively build for the Thingy
set(BOARD thingy52_nrf52832)
set(BOARD_FLASH_RUNNER jlink)
#set(DTC_OVERLAY_FILE boards/mpu9250.overlay)
set(CONF_FILE prj.conf rtt_console.conf bt.conf)

cmake_minimum_required(VERSION 3.13.1)
find_package(Zephyr REQUIRED HINTS $ENV{ZEPHYR_BASE})
project(mobile)

#Add include_directories for libraries, path starts from this files location.
include_directories(inc/
                    lib/)

target_sources(app PRIVATE src/main.c
                           src/mobile_node_ble.c
                           src/mobile_connect.c
                           #src/hal_mpu9250.c
                           src/hal_imu.c
                           lib/zephyr_i2c.c
                           lib/inv_mpu.c
                           lib/inv_mpu_dmp_motion_driver.c
                           )
```

## prj.conf
```kconfig
                                #Console MISC
#------------------------------------------------------------------------------
CONFIG_GPIO=y
```

## bt.conf
```kconfig
#------------------------------------------------------------------------------
                                #BT Config
#------------------------------------------------------------------------------
#BT On
CONFIG_BT=y
#Become an observer 
CONFIG_BT_OBSERVER=y
#BT Log Level Debug
CONFIG_BT_DEBUG_LOG=y

CONFIG_BT_DEVICE_NAME="Splinter"
#Enable support for the Security Manager Protocol (SMP), making it possible to pair devices over LE.
CONFIG_BT_SMP=y
#Enable data signing which is used for transferring authenticated data in an unencrypted connection.
CONFIG_BT_SIGNING=y
#Select this for LE Peripheral role support
CONFIG_BT_PERIPHERAL=y
#Enable GATT Device Information service
CONFIG_BT_DIS=y
#Enable local Privacy Feature support. This makes it possible to use Resolvable Private Addresses (RPAs).
CONFIG_BT_PRIVACY=y
#Bluetooth device appearance. 
CONFIG_BT_DEVICE_APPEARANCE=833
CONFIG_BT_FIXED_PASSKEY=y

# Set the BLE to transmit with +4dbm power
CONFIG_BT_CTLR_TX_PWR_PLUS_8=y

CONFIG_BT_CONN_TX_MAX=16
#CONFIG_BT_CTLR_TX_BUFFERS=16

CONFIG_I2C_LOG_LEVEL_DBG=y
CONFIG_LOG=y
```

## rtt_console.conf
```kconfig
                                #Console RTT Console
#------------------------------------------------------------------------------
CONFIG_PRINTK=y
CONFIG_CBPRINTF_FP_SUPPORT=y

CONFIG_USE_SEGGER_RTT=y
CONFIG_SHELL_BACKEND_SERIAL=n
CONFIG_UART_CONSOLE=n
CONFIG_LOG=y
CONFIG_RTT_CONSOLE=y

CONFIG_NEWLIB_LIBC=y
```

## src/main.c
```c
/**
 ************************************************************************
 * @file main.c
 * @author Wilfred MK, Aaron Helmore
 * @date 04.03.2021
 * @brief Initialises mobile threads
 **********************************************************************
 * */

#include <zephyr.h>
#include <device.h>
#include <devicetree.h>
#include <drivers/gpio.h>
#include <data/json.h>

#include <bluetooth/bluetooth.h>
#include <bluetooth/hci.h>
#include <bluetooth/conn.h>
#include <bluetooth/uuid.h>
#include <bluetooth/gatt.h>

#include <init.h>
#include <drivers/gpio.h>
#include <sys/printk.h>

#include "mobile_node_ble.h"
#include "mobile_connect.h"
#include "hal_imu.h"
//
K_THREAD_DEFINE(ble_scan, STACK_SIZE_BLE_SCAN, thread_ble_scan, NULL, NULL, NULL, THREAD_PRIORITY_BLE_SCAN, 0, 0);
K_THREAD_DEFINE(ble_send, STACK_SIZE_BLE_SEND, thread_ble_send, NULL, NULL, NULL, THREAD_PRIORITY_BLE_SEND, 0, 10);

K_THREAD_DEFINE(ble_led, THREAD_BLE_LED_THREAD_STACK, thread_ble_led, NULL, NULL, NULL, THREAD_PRIORITY_BLE_LED_THREAD, 0, 50);
//BT Enable in ble_connect_thread
K_THREAD_DEFINE(ble_connect, THREAD_BLE_CONNECT_STACK, thread_ble_connect, NULL, NULL, NULL, THREAD_PRIORITY_BLE_CONNECT_THREAD, 0, 0);

//MPU9250 Thread
K_THREAD_DEFINE(imu, THREAD_IMU_RW_STACK, thread_imu_rw, NULL, NULL, NULL, THREAD_PRIORITY_IMU, 0, 100);
```

## inc/hal_imu.h
```c
/**
 ************************************************************************
 * @file hal_imu.h
 * @author Wilfred MK, Aaron Helmore
 * @date 04.03.2021
 * @brief Contains defines and helpers that assist the IMU thread
 **********************************************************************
 * */
#ifndef HAL_IMU_H
#define HAL_IMU_H

/* Debug Thread Stack size */
#define THREAD_IMU_RW_STACK 2048

/* Debug Thread Priority */
#define THREAD_PRIORITY_IMU -1

//Functions

void thread_imu_rw(void);

/* IMU FUNCTIONS */
float getGyroSens(void);

unsigned short getAccelSens(void);

int setSensors(unsigned char sensors);

unsigned short getAccelSens(void);

int updateAccel(void);

int updateGyro(void);

int updateCompass(void);

int setGyroFSR(unsigned short fsr);

int setAccelFSR(unsigned char fsr);

int setLPF(unsigned short lpf);

int setSampleRate(unsigned short rate);

int setCompassSampleRate(unsigned short rate);

bool dataReady(void);

int update(unsigned char sensors);

float calcAccel(int axis);

float calcGyro(int axis);

float calcMag(int axis);

int updateTemperature(void);

int begin(void);

void printIMUData(void);

int dmpLoad(void);

int dmpBegin(unsigned short features, unsigned short fifoRate);

int dmpEnableFeatures(unsigned short mask);

int dmpSetFifoRate(unsigned short rate);

int dmpSetPedometerSteps(unsigned long steps);

int dmpSetPedometerTime(unsigned long time);

unsigned long dmpGetPedometerTime(void);

unsigned long dmpGetPedometerSteps(void);

int dmpBegin(unsigned short features, unsigned short fifoRate);

#endif
```

## inc/imu_driver_defines.h
```c
#ifndef IMU_DRIVER_DEFINES_H
#define IMU_DRIVER_DEFINES_H

#define INV_SUCCESS 0
#define INV_ERROR 0x20

int ax, ay, az;
int gx, gy, gz;
int mx, my, mz;
long qw, qx, qy, qz;
long temperature;
unsigned long time;
float pitch, roll, yaw;
float heading;

enum t_axisOrder
{
    X_AXIS, // 0
    Y_AXIS, // 1
    Z_AXIS  // 2
};

// Define's passed to update(), to request a specific sensor (or multiple):
#define UPDATE_ACCEL (1 << 1)
#define UPDATE_GYRO (1 << 2)
#define UPDATE_COMPASS (1 << 3)
#define UPDATE_TEMP (1 << 4)

#define INT_ACTIVE_HIGH 0
#define INT_ACTIVE_LOW 1
#define INT_LATCHED 1
#define INT_50US_PULSE 0

#define MAX_DMP_SAMPLE_RATE 200 // Maximum sample rate for the DMP FIFO (200Hz)
#define FIFO_BUFFER_SIZE 512    // Max FIFO buffer size

const signed char defaultOrientation[9] = {
    1, 0, 0,
    0, 1, 0,
    0, 0, 1};
#define ORIENT_PORTRAIT 0
#define ORIENT_LANDSCAPE 1
#define ORIENT_REVERSE_PORTRAIT 2
#define ORIENT_REVERSE_LANDSCAPE 3

#endif
```

## inc/mobile_connect.h
```c
/**
 ************************************************************************
 * @file mobile_connect.h
 * @author Wilfred MK, Aaron Helmore
 * @date 20.04.2021
 * @brief Contains required definitions by mobile_connect.c
 **********************************************************************
 **/

#ifndef MOBILE_CONNECT_H
#define MOBILE_CONNECT_H

/* Debug Thread Stack size */
#define THREAD_BLE_LED_THREAD_STACK 1024
#define THREAD_BLE_CONNECT_STACK 2048
/* Debug Thread Priority */
#define THREAD_PRIORITY_BLE_LED_THREAD 20
#define THREAD_PRIORITY_BLE_CONNECT_THREAD -3

//GATT CHARACTERISTIC VALUES
extern uint16_t node_rssi[];
extern uint16_t node_ultra[];

//Contains All scaled Sensor data for in the following format.
//accel_XYZ[0:2], Gyro_XYZ[3:5], Mag_XYZ[6:8]
extern double mpu9250_sensor[];

extern int16_t imu_accel_raw[], imu_gyro_raw[], imu_mag_raw[];

void thread_ble_connect(void);

void thread_ble_led(void);

#endif
```

## inc/mobile_node_ble.h
```c
/**
 ************************************************************************
 * @file mobile_node_ble.h
 * @author Aaron Helmore, Wilfred MK
 * @date 20.04.2021
 * @brief Contains required definitions by mobile_node_ble.c
 **********************************************************************
 **/

#ifndef MOBILE_NODE_BLE_H
#define MOBILE_NODE_BLE_H

#include <zephyr.h>

// Stack size for thread_ble_scan
#define STACK_SIZE_BLE_SCAN 1024

// Thread priority for thread_ble_scan
#define THREAD_PRIORITY_BLE_SCAN 3

// Stack size for thread_ble_send
#define STACK_SIZE_BLE_SEND 1024

// Thread priority for thread_ble_send
#define THREAD_PRIORITY_BLE_SEND 7

// Maximum possible BLE GAP name length
#define BLE_MAX_NAME_LEN 50

// Number of static nodes
#define STATIC_NODE_NUM 4

//Using 280ms period ensures packets aren't lost.
#define MOBILE_BASE_SCAN_PERIOD 280

// Holds all data relevant to a scanned node advertisement
struct NodeData
{
    char name[BLE_MAX_NAME_LEN];
    int8_t rssi;
    int16_t ultrasonic;
};

// Thread to scan for advertisements
void thread_ble_scan(void);

// Thread to display node data
void thread_ble_send(void);

#endif
```

## src/hal_imu.c
```c
/**
 ************************************************************************
 * @file hal_imu.c
 * @author Wilfred MK, Aaron Helmore
 * @date 04.03.2021
 * @brief Reads IMU driver sensors and updates BLE buffer for data transmission
 **********************************************************************
 * */

#include <init.h>
#include <drivers/gpio.h>
#include <sys/printk.h>
#include <drivers/i2c.h>
#include <logging/log.h>
#include <stdio.h>
#include <math.h>

#include "hal_imu.h"
#include "inv_mpu.h"
#include "inv_mpu_dmp_motion_driver.h"
#include "imu_driver_defines.h"
#include "dmpKey.h"
#include "dmpmap.h"
#include "MPU9250_RegisterMap.h"
#include "mobile_connect.h"

LOG_MODULE_REGISTER(IMU_Driver, LOG_LEVEL_ERR);

#define MPU9250_ADDR 0x68
#define MPU9250_WHOAMI_ADDR 0x75

#define USER_CTRL_AD 0x6A
#define INT_BYPASS_CONFIG_AD 0x37

//MPU9250 is connected on i2c0 bus
#define I2C0 DT_LABEL(DT_NODELABEL(i2c0))

//Arduino Constraint
#define constrain(amt, low, high) ((amt) < (low) ? (low) : ((amt) > (high) ? (high) : (amt)))

struct sensorSens
{
    float mSense;
    float aSense;
    float gSense;
};

struct sensorSens mySens = {
    .mSense = 6.665f, // Constant - 4915 / 32760
    .aSense = 0.0f,   // Updated after accel FSR is set
    .gSense = 0.0f    // Updated after gyro FSR is set
};

// Global Senser Vals
unsigned long stepCount = 0;
unsigned long stepTime = 0;
unsigned long lastStepCount = 0;

/**
 * @brief Configures I2C_0 as master
 * 
 * @return int 0 if success
 */
int hal_i2c_configX(void)
{
    /* Obtain pre-initialised device binding - see device_config.h */
    const struct device *dev = device_get_binding(I2C0);

    if (dev == NULL)
    {
        printk("Could not get pointer to I2C2 device struct.\n");
    }

    if (!dev)
    {
        /* Unable to retrive device structure */
        return -ENODEV;
    }
    else
    {
        /*Configure I2C using attained device struct, using the following parameters */
        return i2c_configure(dev, I2C_SPEED_STANDARD | I2C_MODE_MASTER);
    }
}

/**
 * @brief Read and validate WHOAMI register on the MPU9250
 * 
 * @param reg regaddr to read
 * @param buffer buffer to save data into
 * @param size size of data
 * @return int 
 */
int hal_mpu9250_read_regX(uint8_t reg, uint8_t *buffer, int size)
{
    const struct device *dev = device_get_binding(I2C0);

    if (i2c_burst_read(dev, MPU9250_ADDR, reg, buffer, size) == 0)
    {
        return 0;
    }
    return -EIO;
}

/**
 * @brief Set the MPU bypass mode.
 * 
 */
void set_MPU_bypass_mode(void)
{
    hal_i2c_configX();
    const struct device *dev = device_get_binding(I2C0);

    uint8_t buffer;

    if (hal_mpu9250_read_regX(MPU9250_WHOAMI_ADDR, &buffer, sizeof(buffer)) == 0)
    {
        //Read Complete
        if (buffer == 0x71)
        {
            printk("MPU OK\n");
        }
    }

    //Disabled I2C Master Mode
    i2c_reg_write_byte(dev, MPU9250_ADDR, USER_CTRL_AD, 0x00);
    //Turn Bypass MUX on
    i2c_reg_write_byte(dev, MPU9250_ADDR, INT_BYPASS_CONFIG_AD, 0x02);

    //Read AK89XX ACK In Bypass
    i2c_reg_read_byte(dev, 0x0C, 0x00, &buffer);

    if (buffer == 0x48)
    {
        printk("AK8963 OK\n");
    }

    if (hal_mpu9250_read_regX(MPU9250_WHOAMI_ADDR, &buffer, sizeof(buffer)) == 0)
    {
        //Read Complete
        if (buffer == 0x71)
        {
            printk("MPU OK\n");
        }
    }

    //Read AK89XX ACK In Bypass
    i2c_reg_read_byte(dev, 0x0C, 0x00, &buffer);

    if (buffer == 0x48)
    {
        printk("AK8963 OK\n");
    }
}

/**
 * @brief Main thread that handles communication with the IMU Driver.
 * 
 */
void thread_imu_rw(void)
{
    //Set MPU9250 slave bypass MUX
    set_MPU_bypass_mode();

    if (begin() != INV_SUCCESS)
    {
        printk("Error\n");
        return;
    }

    while (1)
    {
        if (dataReady())
        {

            update(UPDATE_ACCEL | UPDATE_GYRO | UPDATE_COMPASS);
            printIMUData();
        }

        k_msleep(10);
    }
}

/**
 * @brief Initialise IMU
 * 
 * @return int ERRVAL
 */
int begin(void)
{

    struct int_param_s int_param;
    int result;
    //uint8_t buffer;

    hal_i2c_configX();

    // Place all slaves (including compass) on primary bus
    if (mpu_set_bypass(1) != 0)
    {
        printk("Slave Error\n");
    }

    k_msleep(10);

    result = mpu_init(&int_param);

    if (result)
    {
        printk("Init Fail\n");
        return result;
    }

    setSensors(INV_XYZ_GYRO | INV_XYZ_ACCEL | INV_XYZ_COMPASS);

    mySens.gSense = getGyroSens();
    mySens.aSense = getAccelSens();
    printk("gSense: %f, aSense: %f\n", mySens.gSense, mySens.aSense);

    //Set Sensor Config
    // Use setGyroFSR() and setAccelFSR() to configure the
    // gyroscope and accelerometer full scale ranges.
    // Gyro options are +/- 250, 500, 1000, or 2000 dps
    setGyroFSR(2000); // Set gyro to 2000 dps
    // Accel options are +/- 2, 4, 8, or 16 g
    setAccelFSR(2); // Set accel to +/-2g
    // Note: the MPU-9250's magnetometer FSR is set at
    // +/- 4912 uT (micro-tesla's)

    // setLPF() can be used to set the digital low-pass filter
    // of the accelerometer and gyroscope.
    // Can be any of the following: 188, 98, 42, 20, 10, 5
    // (values are in Hz).
    setLPF(5); // Set LPF corner frequency to 5Hz

    // The sample rate of the accel/gyro can be set using
    // setSampleRate. Acceptable values range from 4Hz to 1kHz
    setSampleRate(10); // Set sample rate to 10Hz

    // Likewise, the compass (magnetometer) sample rate can be
    // set using the setCompassSampleRate() function.
    // This value can range between: 1-100Hz
    setCompassSampleRate(10); // Set mag rate to 10H

    return result;
}

/**
 * @brief Sets IMU Data to buffer.
 * 
 */
void printIMUData(void)
{
    // float accelX = calcAccel(ax);
    // float accelY = calcAccel(ay);
    // float accelZ = calcAccel(az);
    // float gyroX = calcGyro(gx);
    // float gyroY = calcGyro(gy);
    // float gyroZ = calcGyro(gz);
    // float magX = calcMag(mx);
    // float magY = calcMag(my);
    // float magZ = calcMag(mz);

    imu_accel_raw[0] = ax;
    imu_accel_raw[1] = ay;
    imu_accel_raw[2] = az;

    imu_gyro_raw[0] = gx;
    imu_gyro_raw[1] = gy;
    imu_gyro_raw[2] = gz;

    //printk("aX: %d aY: %d aZ; %d", ax, ay, az);
    // printk("gX: %f gY: %f gZ; %f", gyroX, gyroY, gyroZ);
    //printk("mX: %f mY: %f mZ; %f", mx, my, mz);
}

/**
 * @brief Updates IMU sensor values
 * 
 * @param sensors sensors to select
 * @return int ERRVAL
 */
int update(unsigned char sensors)
{
    int aErr = INV_SUCCESS;
    int gErr = INV_SUCCESS;
    int mErr = INV_SUCCESS;
    int tErr = INV_SUCCESS;

    if (sensors & UPDATE_ACCEL)
        aErr = updateAccel();
    if (sensors & UPDATE_GYRO)
        gErr = updateGyro();
    if (sensors & UPDATE_COMPASS)
        mErr = updateCompass();
    if (sensors & UPDATE_TEMP)
        tErr = updateTemperature();

    return aErr | gErr | mErr | tErr;
}

/**
 * @brief Detect if new data is ready
 * 
 * @return true data ready
 * @return false data not ready
 */
bool dataReady(void)
{
    unsigned char intStatusReg;

    if (mpu_read_reg(MPU9250_INT_STATUS, &intStatusReg) == INV_SUCCESS)
    {
        return (intStatusReg & (1 << INT_STATUS_RAW_DATA_RDY_INT));
    }
    return false;
}

/**
 * @brief Set the Compass Sample Rate 
 * 
 * @param rate sample rate
 * @return int ERR
 */
int setCompassSampleRate(unsigned short rate)
{
    return mpu_set_compass_sample_rate(rate);
}

/**
 * @brief Set the MPU sample rate
 * 
 * @param rate sample rate
 * @return int ERR
 */
int setSampleRate(unsigned short rate)
{
    return mpu_set_sample_rate(rate);
}

/**
 * @brief Set MPU low pass filter
 * 
 * @param lpf lpf value
 * @return int ERR
 */
int setLPF(unsigned short lpf)
{
    return mpu_set_lpf(lpf);
}

/**
 * @brief Set the Accel FSR
 * 
 * @param fsr FSR val
 * @return int ERR
 */
int setAccelFSR(unsigned char fsr)
{
    int err;

    err = mpu_set_accel_fsr(fsr);
    if (err == INV_SUCCESS)
    {
        mySens.aSense = getAccelSens();
    }
    return err;
}

/**
 * @brief Set the Gyro FSR
 * 
 * @param fsr fsr val
 * @return int ERR
 */
int setGyroFSR(unsigned short fsr)
{
    int err;

    err = mpu_set_gyro_fsr(fsr);
    if (err == INV_SUCCESS)
    {
        mySens.gSense = getGyroSens();
    }
    return err;
}

/**
 * @brief Set the Sensors on
 * 
 * @param sensors which sensors
 * @return int ERR
 */
int setSensors(unsigned char sensors)
{
    return mpu_set_sensors(sensors);
}

/**
 * @brief Get the Gyro Sens 
 * 
 * @return float sens
 */
float getGyroSens(void)
{
    float sens;
    if (mpu_get_gyro_sens(&sens) == INV_SUCCESS)
    {
        return sens;
    }
    return 0;
}

/**
 * @brief Get the Accel Sens 
 * 
 * @return unsigned short sens
 */
unsigned short getAccelSens(void)
{
    unsigned short sens;

    if (mpu_get_accel_sens(&sens) == INV_SUCCESS)
    {
        return sens;
    }
    return 0;
}

/**
 * @brief Updata accel info
 * 
 * @return int ERR
 */
int updateAccel(void)
{
    short data[3];

    if (mpu_get_accel_reg(data, &time))
    {
        return INV_ERROR;
    }
    ax = data[X_AXIS];
    ay = data[Y_AXIS];
    az = data[Z_AXIS];
    return INV_SUCCESS;
}
/**
 * @brief Update Gyro info
 * 
 * @return int ERR
 */
int updateGyro(void)
{
    short data[3];

    if (mpu_get_gyro_reg(data, &time))
    {
        return INV_ERROR;
    }
    gx = data[X_AXIS];
    gy = data[Y_AXIS];
    gz = data[Z_AXIS];
    return INV_SUCCESS;
}

/**
 * @brief Update temp info
 * 
 * @return int ERR
 */
int updateTemperature(void)
{
    return mpu_get_temperature(&temperature, &time);
}

/**
 * @brief Update compass info
 * 
 * @return int ERR
 */
int updateCompass(void)
{
    short data[3];

    if (mpu_get_compass_reg(data, &time))
    {
        return INV_ERROR;
    }
    mx = data[X_AXIS];
    my = data[Y_AXIS];
    mz = data[Z_AXIS];
    return INV_SUCCESS;
}

//!SX150B POWER MPU9250 DEVICE ON AT BOOT------DON'T TOUCH----------------START
struct pwr_ctrl_cfg
{
    const char *port;
    uint32_t pin;
};

/**
 * @brief Generic power control function attained from
 *          thingy52/board.c
 * 
 * @param dev device handles
 * @return int return ERR val
 */
static int mpu_ctrl_init(const struct device *dev)
{
    const struct pwr_ctrl_cfg *cfg = dev->config;
    const struct device *gpio;

    gpio = device_get_binding(cfg->port);
    if (!gpio)
    {
        LOG_ERR("Could not bind device \"%s\"\n", cfg->port);
        return -ENODEV;
    }

    gpio_pin_configure(gpio, cfg->pin, GPIO_OUTPUT_HIGH);

    //Delay is required for the i2c rail to stabalize
    k_sleep(K_MSEC(100));

    return 0;
}

// Power up Thingy52 MPU9250 (analog switch) using SX1509B
#define MPU6050_VDD_PWR_CTRL_GPIO_PIN 8
static const struct pwr_ctrl_cfg mpu9250_vdd_pwr_ctrl_cfg = {
    .port = DT_LABEL(DT_INST(0, semtech_sx1509b)),
    .pin = MPU6050_VDD_PWR_CTRL_GPIO_PIN,
};

DEVICE_DEFINE(mpu9250_vdd_pwr_ctrl_initx, "", mpu_ctrl_init, NULL, NULL,
              &mpu9250_vdd_pwr_ctrl_cfg, POST_KERNEL,
              CONFIG_BOARD_CCS_VDD_PWR_CTRL_INIT_PRIORITY, NULL);

//!SX150B POWER MPU9250 DEVICE ON AT BOOT----------------------END
```

## src/mobile_connect.c
```c
/**
 ************************************************************************
 * @file mobile_connect.c
 * @author Wilfred MK, Aaron Helmore
 * @date 20.04.2021
 * @brief Mobile node will adv on BLE and await connection. Sets up 
 *          GATT attritubes for the base to read required data.
 **********************************************************************
 **/
#include <zephyr.h>
#include <device.h>
#include <devicetree.h>
#include <drivers/gpio.h>

#include <bluetooth/bluetooth.h>
#include <bluetooth/hci.h>
#include <bluetooth/conn.h>
#include <bluetooth/uuid.h>
#include <bluetooth/gatt.h>
#include <sys/byteorder.h>

#include "mobile_node_ble.h"
#include "mobile_connect.h"

/* 1000 msec = 1 sec */
#define BLE_DISC_SLEEP_MS 250
#define BLE_CONN_SLEEP_MS 1000
#define SHORT_SLEEP_MS 50

/* The devicetree node identifier for the "led0" alias. */
#define LED0_NODE DT_ALIAS(led0)

#define LED0 DT_GPIO_LABEL(LED0_NODE, gpios)
#define PIN DT_GPIO_PIN(LED0_NODE, gpios)
#define FLAGS DT_GPIO_FLAGS(LED0_NODE, gpios)

static const struct bt_data ad[] = {
    BT_DATA_BYTES(BT_DATA_FLAGS, (BT_LE_AD_GENERAL | BT_LE_AD_NO_BREDR)),
    BT_DATA_BYTES(BT_DATA_UUID128_ALL,
                  0xd0, 0x92, 0x67, 0x35, 0x78, 0x16, 0x21, 0x91,
                  0x26, 0x49, 0x60, 0xeb, 0x06, 0xa7, 0xca, 0xcb),
};

//Keeps Track of BLE connection within APP
bool ble_conencted = false;

//!XXXXXXXXXXXXXXXXXXXXXXXXXXXXXXXXXXXXXXXXXXXXXXXXXXXXXXXXXXXXXXXXXXXXXXXXXX
//!XXXXXXXXXXXXXXXXXXXXXXXXXXXXXXXXXXXXXXXXXXXXXXXXXXXXXXXXXXXXXXXXXXXXXXXXXX
//TEST SERVIES N STUFF HERE
/* Custom Service Variables */
static struct bt_uuid_128 mobile_uuid = BT_UUID_INIT_128(
    0xd0, 0x92, 0x67, 0x35, 0x78, 0x16, 0x21, 0x91,
    0x26, 0x49, 0x60, 0xeb, 0x06, 0xa7, 0xca, 0xcb);

static struct bt_uuid_128 node_ultra_uuid = BT_UUID_INIT_128(
    0xd1, 0x92, 0x67, 0x35, 0x78, 0x16, 0x21, 0x91,
    0x26, 0x49, 0x60, 0xeb, 0x06, 0xa7, 0xca, 0xcb);

static struct bt_uuid_128 node_rssi_uuid = BT_UUID_INIT_128(
    0xd2, 0x92, 0x67, 0x35, 0x78, 0x16, 0x21, 0x91,
    0x26, 0x49, 0x60, 0xeb, 0x06, 0xa7, 0xca, 0xcb);

static struct bt_uuid_128 imu_accel_uuid = BT_UUID_INIT_128(
    0xd3, 0x92, 0x67, 0x35, 0x78, 0x16, 0x21, 0x91,
    0x26, 0x49, 0x60, 0xeb, 0x06, 0xa7, 0xca, 0xcb);

static struct bt_uuid_128 imu_gyro_uuid = BT_UUID_INIT_128(
    0xd4, 0x92, 0x67, 0x35, 0x78, 0x16, 0x21, 0x91,
    0x26, 0x49, 0x60, 0xeb, 0x06, 0xa7, 0xca, 0xcb);

static struct bt_uuid_128 imu_mag_uuid = BT_UUID_INIT_128(
    0xd5, 0x92, 0x67, 0x35, 0x78, 0x16, 0x21, 0x91,
    0x26, 0x49, 0x60, 0xeb, 0x06, 0xa7, 0xca, 0xcb);

//GATT CHARACTERISTIC VALUES
uint16_t node_rssi[] = {0x00, 0x00, 0x00, 0x00};
uint16_t node_ultra[] = {0x00, 0x00, 0x00, 0x00};

int16_t imu_accel_raw[] = {0x00, 0x00, 0x00};
int16_t imu_gyro_raw[] = {0x00, 0x00, 0x00};
int16_t imu_mag_raw[] = {0x00, 0x00, 0x00};

/**
 * @brief Callback funtion to read RSSI buffer.
 * 
 * @param conn connection handler
 * @param attr Attribute data/user data
 * @param buf Buffer storing the value
 * @param len Length of data
 * @param offset Data offset for multiple reads
 * @return ssize_t 0, to stop continous reads. 
 */
static ssize_t read_rssi(struct bt_conn *conn,
                         const struct bt_gatt_attr *attr, void *buf,
                         uint16_t len, uint16_t offset)
{
    const int16_t *value = attr->user_data;

    return bt_gatt_attr_read(conn, attr, buf, len, offset, value,
                             sizeof(node_rssi));
}

/**
 * @brief Callback funtion to read Ultra buffer.
 * 
 * @param conn connection handler
 * @param attr Attribute data/user data
 * @param buf Buffer storing the value
 * @param len Length of data
 * @param offset Data offset for multiple reads
 * @return ssize_t 0, to stop continous reads. 
 */
static ssize_t read_ultra(struct bt_conn *conn,
                          const struct bt_gatt_attr *attr, void *buf,
                          uint16_t len, uint16_t offset)
{
    const int16_t *value = attr->user_data;

    return bt_gatt_attr_read(conn, attr, buf, len, offset, value,
                             sizeof(node_ultra));
}

/**
 * @brief Callback funtion to read sensor array data
 * 
 * @param conn connection handler
 * @param attr Attribute data/user data
 * @param buf Buffer storing the value
 * @param len Length of data
 * @param offset Data offset for multiple reads
 * @return ssize_t 0, to stop continous reads. 
 */
static ssize_t read_sensor_array(struct bt_conn *conn,
                                 const struct bt_gatt_attr *attr, void *buf,
                                 uint16_t len, uint16_t offset)
{
    const int16_t *value = attr->user_data;

    return bt_gatt_attr_read(conn, attr, buf, len, offset, value,
                             sizeof(imu_accel_raw));
}

//Helper Macro to define BLE Gatt Attributes based on CX UUIDS
BT_GATT_SERVICE_DEFINE(mobile_svc,
                       BT_GATT_PRIMARY_SERVICE(&mobile_uuid),

                       BT_GATT_CHARACTERISTIC(&node_ultra_uuid.uuid,
                                              BT_GATT_CHRC_READ,
                                              BT_GATT_PERM_READ,
                                              read_ultra, NULL, &node_ultra),

                       BT_GATT_CHARACTERISTIC(&node_rssi_uuid.uuid,
                                              BT_GATT_CHRC_READ,
                                              BT_GATT_PERM_READ,
                                              read_rssi, NULL, &node_rssi),

                       BT_GATT_CHARACTERISTIC(&imu_accel_uuid.uuid,
                                              BT_GATT_CHRC_READ,
                                              BT_GATT_PERM_READ,
                                              read_sensor_array, NULL, &imu_accel_raw),

                       BT_GATT_CHARACTERISTIC(&imu_gyro_uuid.uuid,
                                              BT_GATT_CHRC_READ,
                                              BT_GATT_PERM_READ,
                                              read_sensor_array, NULL, &imu_gyro_raw),

                       BT_GATT_CHARACTERISTIC(&imu_mag_uuid.uuid,
                                              BT_GATT_CHRC_READ,
                                              BT_GATT_PERM_READ,
                                              read_sensor_array, NULL, &imu_mag_raw), );

/**
 * @brief Connection call back
 * 
 * @param conn conenction handler
 * @param err err val
 */
static void connected(struct bt_conn *conn, uint8_t err)
{
    if (err)
    {
        printk("Connection failed (err 0x%02x)\n", err);
        ble_conencted = false;
    }
    else
    {
        printk("BLE Connected to Device\n");
        ble_conencted = true;
        struct bt_le_conn_param *param = BT_LE_CONN_PARAM(6, 6, 0, 400);

        if (bt_conn_le_param_update(conn, param) < 0)
        {
            while (1)
            {
                printk("Connection Update Error\n");
                k_msleep(10);
            }
        }
    }
}

/**
 * @brief Disconnect Callback, used to keep track of connection status 
 *          in the application layer
 * 
 * @param conn connection handler
 * @param reason disconnect reason.
 */
static void disconnected(struct bt_conn *conn, uint8_t reason)
{
    printk("Disconnected (reason 0x%02x)\n", reason);
    ble_conencted = false;
}

/**
 * @brief Passcode handler for accessing encrypted data
 * 
 * @param conn connection handler
 * @param passkey passkey
 */
static void auth_passkey_display(struct bt_conn *conn, unsigned int passkey)
{
    char addr[BT_ADDR_LE_STR_LEN];

    bt_addr_le_to_str(bt_conn_get_dst(conn), addr, sizeof(addr));

    printk("Passkey for %s: %06u\n", addr, passkey);
}

/**
 * @brief Authorisation cancelled handler
 * 
 * @param conn conenction handler
 */
static void auth_cancel(struct bt_conn *conn)
{
    char addr[BT_ADDR_LE_STR_LEN];

    bt_addr_le_to_str(bt_conn_get_dst(conn), addr, sizeof(addr));

    printk("Pairing cancelled: %s\n", addr);
}

/**
 * @brief Conn callback data structs, holds
 *          function pointers.
 * 
 */
static struct bt_conn_cb conn_callbacks = {
    .connected = connected,
    .disconnected = disconnected,
};
/**
 * @brief Conn AUTH callback data structs, holds
 *          function pointers.
 * 
 */
static struct bt_conn_auth_cb auth_cb_display = {
    .passkey_display = auth_passkey_display,
    .passkey_entry = NULL,
    .cancel = auth_cancel,
};

/**
 * @brief Initialises bluetooth, and begins advertising data
 *            on BLE.
 * 
 */
static void bt_ready(void)
{
    int err;

    err = bt_enable(NULL);
    if (err)
    {
        printk("Bluetooth init failed (err %d)\n", err);
        return;
    }

    printk("Bluetooth initialized\n");

    if (IS_ENABLED(CONFIG_SETTINGS))
    {
        //settings_load();
    }

    err = bt_le_adv_start(BT_LE_ADV_CONN_NAME, ad, ARRAY_SIZE(ad), NULL, 0);

    if (err)
    {
        printk("Advertising failed to start (err %d)\n", err);
        return;
    }
    //bt_passkey_set(0xAA289);
    printk("Advertising successfully started\n");
}

/**
 * @brief Enabled bluetooth, and sets connection callback handler, awaits
 *          central to connect to peripheral (mobile)
 * 
 */
void thread_ble_connect(void)
{
    bt_ready();

    bt_conn_cb_register(&conn_callbacks);
    bt_conn_auth_cb_register(&auth_cb_display);

    while (1)
    {
        k_msleep(SHORT_SLEEP_MS);
    }
}

/**
 * @brief Enable GPIO led pins
 * 
 */
void led_gpio_enable(void)
{
    int ret = gpio_pin_configure(device_get_binding(LED0), PIN, GPIO_OUTPUT_ACTIVE | FLAGS);
    if (ret < 0)
    {
        return;
    }
}

/**
 * @brief Debug blink led thread, blinks LED based on conenction status.
 * 
 */
void thread_ble_led(void)
{
    bool led_is_on = true;
    led_gpio_enable();

    while (1)
    {
        led_is_on = !led_is_on;
        gpio_pin_set(device_get_binding(LED0), PIN, (int)led_is_on);

        if (ble_conencted)
        {
            k_msleep(BLE_CONN_SLEEP_MS);
        }
        else
        {
            k_msleep(BLE_DISC_SLEEP_MS);
        }
    }
}
```

## src/mobile_node_ble.c
```c
/**
 ************************************************************************
 * @file mobile_node_ble.c
 * @author Aaron Helmore, Wilfred MK
 * @date 20.04.2021
 * @brief Read adv data broadcast (BLE) by static nodes and parses them 
 *          appropriately, works together with mobile_connect to update 
 *          internal buffer so that base can read the most up to data
 *          static node information.
 **********************************************************************
 **/

#include <zephyr.h>
#include <stddef.h>

#include <stdbool.h>
#include <string.h>

#include <sys/printk.h>
#include <sys/util.h>

#include <bluetooth/bluetooth.h>
#include <bluetooth/hci.h>

#include "mobile_node_ble.h"
#include "mobile_connect.h"

// Holds received advertisement data from each node
static struct NodeData nodeData[STATIC_NODE_NUM];

// Semaphores to signal that advertisement was received from node at that index
static struct k_sem scannedSems[STATIC_NODE_NUM];

// Semaphore to signal that a scan has been completed
static struct k_sem scanDoneSem;

// Static node GAP names according to index
const char *nodeNames[] = {
    "Leonardo_U",
    "Raphael_U",
    "Michelangelo",
    "Donatello"};

/**
 * @brief Initialise all semaphores used in BLE advertisement scanning
 */
static void scanned_sem_init(void)
{
    k_sem_init(&scanDoneSem, 0, 1);

    for (int i = 0; i < STATIC_NODE_NUM; ++i)
    {

        k_sem_init(&scannedSems[i], 0, 1);
    }
}

/**
 * @brief Callback function to extract GAP name and ultrasonic data from BLE
 *          advertisements
 * 
 * @param data : Data to parse
 * @param user_data : Container to save parsed data to
 * @return true : If parsing should continue
 * @return false : If parsing should stop
 */
static bool parse_advertising_data(struct bt_data *data, void *user_data)
{
    struct NodeData *parsedData = user_data;

    // Check if the data is the advertiser's name
    if (data->type == BT_DATA_NAME_COMPLETE)
    {

        // If the name length is valid, save it and stop parsing
        if (data->data_len < BLE_MAX_NAME_LEN)
        {

            memcpy(parsedData->name, data->data, data->data_len);
            parsedData->name[data->data_len] = '\0';

            return true;
        }
    }
    else if (data->type == BT_DATA_MANUFACTURER_DATA)
    {

        // If data is correct length, try save it as ultrasonic data
        if (data->data_len == 2 * sizeof(uint16_t))
        {

            parsedData->ultrasonic = ((int16_t)(data->data[2]) << 8) | data->data[3];

            return false;
        }
    }

    return true;
}

/**
 * @brief Callback for when an advertisement has been found
 * 
 * @param addr : BLE address of the advertiser
 * @param rssi : Received signal strength indicator of the advertisement
 * @param advType : Type of advertisement
 * @param ad : The scanned advertisement
 */
static void scan_cb(const bt_addr_le_t *addr, int8_t rssi, uint8_t advType, struct net_buf_simple *ad)
{
    struct NodeData adData = {0};

    bt_data_parse(ad, parse_advertising_data, &adData);

    for (int i = 0; i < STATIC_NODE_NUM; ++i)
    {

        // See if a valid node; if so, save data
        if (strcmp(adData.name, nodeNames[i]) == 0)
        {

            nodeData[i].rssi = rssi;

            //
            // Check if the node is an ultrasonic node, if so save data
            nodeData[i].ultrasonic = (adData.name[strlen(adData.name) - 1] == 'U') ? adData.ultrasonic : -1;

            k_sem_give(&scannedSems[i]);
        }
    }
}

/**
 * @brief Thread to scan for BLE advertisements
 */
void thread_ble_scan(void)
{
    // Setup passive scan with 40ms interval 40ms window (constant scan)
    struct bt_le_scan_param scanParams = {
        .type = BT_HCI_LE_SCAN_PASSIVE,
        .options = BT_LE_SCAN_OPT_NONE,
        .interval = 0x0040,
        .window = 0x0040};
    int err;

    // Initialise all semaphores used in scanning routine
    scanned_sem_init();

    err = bt_le_scan_start(&scanParams, scan_cb);
    if (err)
    {

        printk("Starting scanning failed (err %d)\n", err);
        return;
    }

    while (1)
    {

        // Wait for the period time then signal scan complete
        k_msleep(MOBILE_BASE_SCAN_PERIOD);

        k_sem_give(&scanDoneSem);
    }
}

/**
 * @brief Thread to print static node ads to console
 * NOTE: THIS WILL BE DEPRECIATED
 */
void thread_ble_send(void)
{
    int err;
    int total = 0, missed = 0;

    while (1)
    {

        k_sem_take(&scanDoneSem, K_FOREVER);

        printk("Scan done\n");

        ++total;

        for (int i = 0; i < STATIC_NODE_NUM; ++i)
        {

            // Wait max 10ms before deciding that nodes ad was missed
            err = k_sem_take(&scannedSems[i], K_MSEC(10));
            if (err == -EAGAIN)
            {

                if (i == 0)
                {
                    ++missed;
                }
                // sem_take timed out, data was therefore missed
                printk("Node %d ad was missed\n", i + 1);
            }
            else
            {

                printk("rssi: %d, ultra: %d\n", nodeData[i].rssi, nodeData[i].ultrasonic);
                //Update GATT Characteristic Buffers
                node_rssi[i] = nodeData[i].rssi;
                node_ultra[i] = nodeData[i].ultrasonic;
            }
        }
    }
}
```
